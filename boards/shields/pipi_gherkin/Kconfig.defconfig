## boards/shields/pipi_gherkin/Kconfig.defconfig
```kconfig
if SHIELD_PIPI_GHERKIN

# Name must be less than 16 characters long!
config ZMK_KEYBOARD_NAME
    default "PiPi Gherkin"

    config ZEPHYR_HAL_INFINEON_MODULE
        default y

    config I2C
        default y
endif
```
